## components/ble_log_bridge_firmware/main/Kconfig.projbuild
```kconfig
menu "BLE Log Bridge"

config BRIDGE_SPI_TRANSACTION_SIZE
    int "SPI slave transaction size"
    range 1 4092
    default 2048

config BRIDGE_SPI_QUEUE_DEPTH
    int "SPI slave DMA queue depth"
    range 1 128
    default 128

config BRIDGE_STOP_DRAIN_TIMEOUT_MS
    int "STOP CDC drain timeout (ms)"
    range 0 10000
    default 2000

endmenu
```

## components/ble_log_bridge_firmware/sdkconfig.defaults
```kconfig
CONFIG_IDF_TARGET="esp32p4"
CONFIG_ESPTOOLPY_FLASHMODE_QIO=y
CONFIG_ESPTOOLPY_FLASHSIZE_16MB=y
CONFIG_PARTITION_TABLE_CUSTOM=y
CONFIG_PARTITION_TABLE_CUSTOM_FILENAME="partitions.csv"
CONFIG_BOOTLOADER_APP_ROLLBACK_ENABLE=y
CONFIG_BOOTLOADER_LOG_LEVEL_WARN=y
CONFIG_FREERTOS_HZ=1000
CONFIG_TINYUSB_CDC_ENABLED=y
CONFIG_TINYUSB_CDC_COUNT=1
CONFIG_TINYUSB_CDC_RX_BUFSIZE=512
CONFIG_TINYUSB_CDC_TX_BUFSIZE=32768
CONFIG_TINYUSB_HID_COUNT=1
CONFIG_TINYUSB_DFU_MODE_DFU=y
CONFIG_TINYUSB_DFU_BUFSIZE=4096
CONFIG_BRIDGE_SPI_TRANSACTION_SIZE=2048
CONFIG_BRIDGE_SPI_QUEUE_DEPTH=128
CONFIG_BRIDGE_STOP_DRAIN_TIMEOUT_MS=2000
```
